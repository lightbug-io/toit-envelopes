## variants/esp32s3-no-spram/sdkconfig.defaults
```kconfig
# Disable PSRAM/SPIRAM for this variant to avoid PSRAM pin restrictions.
# This is the canonical defconfig form for CONFIG_SPIRAM=n.
# CONFIG_SPIRAM is not set
```
